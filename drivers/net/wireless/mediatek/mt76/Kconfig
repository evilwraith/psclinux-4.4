## drivers/net/wireless/mediatek/mt76/Kconfig
```kconfig
# SPDX-License-Identifier: GPL-2.0-only
config MT76_CORE
	tristate "Mediatek MT76"

#config MT76_LEDS
#	bool
#	depends on MT76_CORE
#	depends on LEDS_CLASS=y || MT76_CORE=LEDS_CLASS
#	default y

config MT76_USB
	tristate "Mediatek MT76 USB"
	depends on MT76_CORE

config MT76x02_LIB
	tristate "Mediatek MT76 LIBS"
	select MT76_CORE

config MT76x02_USB
	tristate "Mediatek MT76 MT76x02_USB"
	select MT76_USB

source "drivers/net/wireless/mediatek/mt76/mt76x0/Kconfig"
source "drivers/net/wireless/mediatek/mt76/mt76x2/Kconfig"
source "drivers/net/wireless/mediatek/mt76/mt7603/Kconfig"
source "drivers/net/wireless/mediatek/mt76/mt7615/Kconfig"
```
